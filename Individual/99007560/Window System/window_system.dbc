VERSION ""

NS_ :

BS_:

BU_: Output Logic Input

BO_ 170 ACK: 8 Output

BO_ 1 Window_Module: 1 Input
 SG_ Power_Window : 0|8@1- (1,0) [0|0] "" Vector__XXX

BA_DEF_  "BusType" STRING ;
BA_DEF_DEF_  "BusType" "CAN";
