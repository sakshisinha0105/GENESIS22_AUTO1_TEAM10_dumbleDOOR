VERSION ""

NS_ :

BS_:

BU_: ECU3 ECU2 ECU1

BO_ 170 ECU1_Ack: 8 ECU1
 SG_ Acknow : 0|8@1- (1,0) [0|0] "" Vector__XXX

BO_ 2 DoorLockStatus: 1 ECU2
 SG_ Doorlock : 0|8@1- (1,0) [0|0] "" Vector__XXX

BO_ 1 CarSpeedValue: 1 ECU3
 SG_ Speed : 0|8@1- (1,0) [0|0] "" Vector__XXX

BA_DEF_  "BusType" STRING ;
BA_DEF_DEF_  "BusType" "CAN";
