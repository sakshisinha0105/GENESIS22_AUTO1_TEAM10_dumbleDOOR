/*@!Encoding:1252*/
includes
{
  
}

variables
{
  message ACK ACK1;
  int retVal =0;
  const int POS_ACK = 0x55;
  const int NEG_ACK = 0xAA;
  
}
on message MirrorFold
{
  if($MirrorFoldSignal==1 && @Ignition::KL15 ==1)
  {
   
    write("Windows unfolded");
    ACK1.byte(0) = POS_ACK;
    output(ACK1);
    setControlVisibility("SpeedPanel","Mirror",1);
  }
  else
  {
    write("Windows folded");
    ACK1.byte(0) = NEG_ACK;
    output(ACK1);
    setControlVisibility("SpeedPanel","Mirror",0);
  }
}
on start
{
  write("In Start - Output");
}
