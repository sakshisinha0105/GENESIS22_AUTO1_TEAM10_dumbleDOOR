VERSION ""

NS_ :

BS_:

BU_: Output Logic Input

BO_ 170 ACK: 4 Output

BO_ 2 MirrorFold: 1 Logic
 SG_ MirrorFoldSignal : 0|8@1- (1,0) [0|0] "" Vector__XXX

BO_ 1 CarSpeed: 1 Output
 SG_ Speed : 0|8@1- (1,0) [0|0] "" Vector__XXX

BO_TX_BU_ 1 : Output,Input;

BA_DEF_  "BusType" STRING ;
BA_DEF_DEF_  "BusType" "CAN";
