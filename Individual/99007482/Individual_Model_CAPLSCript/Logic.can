/*@!Encoding:1252*/
includes
{
  
}

variables
{
  Timer SpeedTmr;
  message MirrorFold MSG_MRR_FLD;
  message CarSpeed SPD_MSG;
  
  const int THRESHOLD_SPEED = 20;
  const int MIN_SPEED = 0;
}

on sysvar Ignition::KL15
{
  if(@Ignition::KL15==1)
  {
    write("Ignition ON");
  }
  else
  {
    write("Ignition OFF");
    write("Mirror cannot be folded as Ignition is OFF");
    //setSignal(MirrorFold,0);
  }  
}
on start
{
  write("Started CANoe");
  setControlVisibility("TrialPanel1","MirrorFold1",1);
}
on stopMeasurement
{
  write("CANoe Stopped");
  $MirrorFold = 0;
  setControlVisibility("TrialPanel1","MirrorFold1",1);
}

on message CarSpeed
{
  write("Inside msg loop");
  if ($Speed> THRESHOLD_SPEED)
  {
     if(@Ignition::KL15==1)
     { 
      write("Logic: speed tmr starting");
      setTimer(SpeedTmr,2);
      //setSignal(MirrorFold,0);
     }
    else
    {
      write("Error");
      //setSignal(MirrorFold,0);
    }
  }
   if($Speed < THRESHOLD_SPEED&&$Speed> MIN_SPEED)
   {
     if(@Ignition::KL15==1)
     {
      write("Logic: Speed less than 20");
      $MirrorFold = 0;
      //setSignal(MirrorFold,0);
    }
    else
    {
      write("Error");
      //setSignal(MirrorFold,0);
    }
  }
}

on timer SpeedTmr
{
  if(@Ignition::KL15==1&& $Speed > THRESHOLD_SPEED)
  {
    $MirrorFold=1;
    write("Logic says - Mirror can be folded");
  }
  else
  {
    write("Ignition OFF");
    $MirrorFold=0;
    write("Logic says - Mirror cannot be folded as Ignition is OFF");
  }
}
