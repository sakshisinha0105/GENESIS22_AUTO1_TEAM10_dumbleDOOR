/*@!Encoding:1252*/
includes
{
  
}
variables
{
  message ECU1_Ack ACK1;
  int retVal = 0;
  const int POSITIVE_ACK = 0x55;  
  const int NEGATIVE_ACK = 0xAA;
}

on message DoorLockStatus//msg from ECU2
{
  if(($DoorLock == 1) && (@KL15::KL15 == 1))
  {
    //Doors lock mechanism code
    write("DOORS Locked by Body Electronics ECU"); 
    ACK1.byte(0) = POSITIVE_ACK;//positive ack
    output(ACK1);
    setControlVisibility("TrailPanel1","DoorLock1",0);
  }
  else
  {
    write("DOORS not locked by Body Elec ECU");
    ACK1.byte(0) = NEGATIVE_ACK;//negative ack
    output(ACK1);
    setControlVisibility("TrailPanel1","DoorLock1",1);
  }
}


on start{
    write("in start - ECU1");
}


