VERSION ""

NS_ :

BS_:

BU_: ECU3 ECU2 ECU1

BO_ 170 ECU1_Ack: 1 ECU1

BO_ 2 DoorLockStatus: 1 ECU2
 SG_ DoorLock : 0|1@1+ (1,0) [0|1] "" Vector__XXX

BO_ 1 CarSpeedValue: 4 ECU3
 SG_ Speed : 0|8@1+ (1,0) [0|180] "km / hour" Vector__XXX

CM_ SG_ 2 DoorLock "Signal is responsible for displaying, controlling the Cenrtralised Door locking mechanism in a vehicle.
0 - doors not to be locked
1 - doors to be locked";
CM_ SG_ 1 Speed "Signal used for monitoring and controlling the car speed value, in kilometers per hour.";
BA_DEF_  "BusType" STRING ;
BA_DEF_DEF_  "BusType" "CAN";
