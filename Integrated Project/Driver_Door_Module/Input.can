/*@!Encoding:1252*/
includes
{
  
}

variables
{
  timer SpeedValue1;
  timer SpeedValue2;
  message CarSpeed msg;
  timer WindowGlassValue1;
  timer WindowGlassValue2;
  timer WindowGlassValue3;
  timer WindowGlassValue4;
  timer WindowGlassValue5;
  timer WindowGlassValue6;
  timer WindowGlassValue7;
  timer WindowGlassValue8;
  message Window_Module msg1;
}
on sysvar Ignition::KL15
{
  if(@Ignition::KL15==1 && @Ignition::windowStart==1)
  {
    write("Ignition is ON");
    output(msg);
    setTimer(SpeedValue1,5);
    setTimer(SpeedValue2,6);
    output(msg1);
    setTimer(WindowGlassValue1,7);
    setTimer(WindowGlassValue2,8);
    setTimer(WindowGlassValue3,9);
    setTimer(WindowGlassValue4,10);
    setTimer(WindowGlassValue5,10);
    setTimer(WindowGlassValue6,11);
    setTimer(WindowGlassValue7,12);
    setTimer(WindowGlassValue8,13);
  }
  else
  {
   write("Ignition is OFF"); 
   $Speed = 0;
   cancelTimer(SpeedValue1);
   cancelTimer(SpeedValue2);
   $Power_Window = 0;
   cancelTimer(WindowGlassValue1);
   cancelTimer(WindowGlassValue2);
   cancelTimer(WindowGlassValue3);
   cancelTimer(WindowGlassValue4);
   cancelTimer(WindowGlassValue5);
   cancelTimer(WindowGlassValue6);
   cancelTimer(WindowGlassValue7);
   cancelTimer(WindowGlassValue8); 
  }
}
on timer SpeedValue1
{
  output(msg);
  setTimer(SpeedValue1,5);
}
on timer SpeedValue2
{
  output(msg);
  setTimer(SpeedValue2,6);
}

on timer WindowGlassValue1
{
  output(msg);
  @Ignition::windO=25;
  setTimer(WindowGlassValue1,7);
}
on timer WindowGlassValue2
{
  output(msg);
  @Ignition::windO=50;
  setTimer(WindowGlassValue2,8);
}

on timer WindowGlassValue3
{
  output(msg);
  @Ignition::windO=75;
  setTimer(WindowGlassValue3,9);
}
on timer WindowGlassValue4
{
  output(msg);
  @Ignition::windO=100;
  setTimer(WindowGlassValue4,10);
}
on timer WindowGlassValue5
{
  output(msg);
  @Ignition::windO=75;
  setTimer(WindowGlassValue5,11);
}
on timer WindowGlassValue6
{
  output(msg);
  @Ignition::windO=50;
  setTimer(WindowGlassValue6,12);
}
on timer WindowGlassValue7
{
  output(msg);
  @Ignition::windO=25;
  setTimer(WindowGlassValue7,13);
}
on timer WindowGlassValue8
{
  output(msg);
  @Ignition::windO =0;
  setTimer(WindowGlassValue8,14);
}

on stopMeasurement
{
  $Speed=0;



  $Power_Window=0;
}



