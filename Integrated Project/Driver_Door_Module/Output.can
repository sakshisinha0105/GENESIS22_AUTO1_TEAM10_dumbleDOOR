/*@!Encoding:1252*/
includes
{
  
}

variables
{
  message ACK ACK1;
  int retVal =0;
  const int POS_ACK = 0x55;
  const int NEG_ACK = 0xAA;
  
}
on message MirrorFold
{
  if($MirrorFoldSignal==1 && @Ignition::KL15 ==1)
  {
   
    write("Windows unfolded");
    ACK1.byte(0) = POS_ACK;
    output(ACK1);
    setControlVisibility("SpeedPanel","Mirror",1);
  }
  else
  {
    write("Windows folded");
    ACK1.byte(0) = NEG_ACK;
    output(ACK1);
    setControlVisibility("SpeedPanel","Mirror",0);
  }
}

on message DoorLockStatus//msg from ECU2
{
  if(($DoorLock == 1) && (@Ignition::KL15 == 1))
  {
    //Doors lock mechanism code
    write("DOORS Locked by Body Electronics ECU"); 
    ACK1.byte(0) = POS_ACK;//positive ack
    output(ACK1);
    setControlVisibility("SpeedPanel","DoorLock1",0);
  }
  else
  {
    write("DOORS not locked by Body Elec ECU");
    ACK1.byte(0) = NEG_ACK;//negative ack
    output(ACK1);
    setControlVisibility("SpeedPanel","DoorLock1",1);
  }
}
on message Window_Module//msg from ECU2
{
  if(($Power_Window == 1) && (@Ignition::KL15 == 1))
  {
    
    ACK1.byte(0) = POS_ACK;//positive ack
    output(ACK1);
    
  }
  else
  {
    ACK1.byte(0) = NEG_ACK;//negative ack
    output(ACK1);
  }
}
on start
{
  write("In Start - Output");
  @Ignition::windO=0; 
}
